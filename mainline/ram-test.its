## mainline/ram-test.its
```
/dts-v1/;
/ {
    description = "miZy H2+ Linux 6.12.113 RAM test";
    #address-cells = <1>;
    images {
        kernel-1 {
            description = "Linux 6.12.113-mizy-h2plus";
            data = /incbin/("Image.lzma");
            type = "kernel"; arch = "arm"; os = "linux";
            compression = "lzma";
            load = <0x40008000>; entry = <0x40008000>;
            hash-1 { algo = "crc32"; };
        };
        ramdisk-1 {
            description = "Read-only original miZy with mainline overlay";
            data = /incbin/("bootstrap.cpio.gz");
            type = "ramdisk"; arch = "arm"; os = "linux";
            compression = "gzip";
            load = <0x44000000>;
            hash-1 { algo = "crc32"; };
        };
        fdt-1 {
            data = /incbin/("board.dtb");
            type = "flat_dt"; arch = "arm"; compression = "none";
            hash-1 { algo = "crc32"; };
        };
    };
    configurations {
        default = "test";
        test { kernel = "kernel-1"; ramdisk = "ramdisk-1"; fdt = "fdt-1"; };
    };
};
```
